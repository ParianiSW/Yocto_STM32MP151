## meta-pariani/conf/distro/pariani-st.conf
```bitbake
# =========================================================================
# Pariani custom distribution based on ST OpenSTLinux Weston
# =========================================================================

# Inherit ST base distro rules and providers
require conf/distro/include/st-default-distro-rules.inc
require conf/distro/include/st-default-distro-providers.inc
require conf/distro/include/openstlinux.inc

# =========================================================================
# Distribution identity
# =========================================================================
DISTRO = "pariani-st"
DISTRO_NAME = "Pariani ST Distribution"
DISTRO_VERSION = "1.0"

# =========================================================================
# DISTRO features
# =========================================================================

# Base features: Wayland only, no X11
#DISTRO_FEATURES:append = " wayland "
#DISTRO_FEATURES:remove = " x11 opengl vulkan opencl "
DISTRO_FEATURES:append = " wayland opengl "
DISTRO_FEATURES:remove = " x11 "
# feature remove 
DISTRO_FEATURES:remove = " wifi "


# Enable GPLv3 components
DISTRO_FEATURES:append = " gplv3 "

# does not build otherwise
# activate GPU Vulkan & opencl
DISTRO_FEATURES:append = " ${@bb.utils.filter('MACHINE_FEATURES', 'vulkan opencl', d)} "

# =========================================================================
# Include Pariani modular snippets
# =========================================================================

# config snippet
require ${TOPDIR}/../layers/Yocto_STM32MP151/meta-pariani/conf/snippets/qt5-minimal-scarthgap.conf
require ${TOPDIR}/../layers/Yocto_STM32MP151/meta-pariani/conf/snippets/system-tools-scarthgap.conf
require ${TOPDIR}/../layers/Yocto_STM32MP151/meta-pariani/conf/snippets/toolchain-scarthgap.conf
require ${TOPDIR}/../layers/Yocto_STM32MP151/meta-pariani/conf/snippets/pariani-partitions.conf
require ${TOPDIR}/../layers/Yocto_STM32MP151/meta-pariani/conf/snippets/disable-splash-scarthgap.conf
```

## meta-pariani/conf/layer.conf
```bitbake
# meta-pariani layer
BBPATH .= ":${LAYERDIR}"

BBFILES += "\
  ${LAYERDIR}/recipes-*/*/*.bb \
  ${LAYERDIR}/recipes-*/*/*.bbappend \
"
BBFILE_COLLECTIONS += "meta-pariani"
BBFILE_PATTERN_meta-pariani = "^${LAYERDIR}/"
BBFILE_PRIORITY_meta-pariani = "9"

LAYERSERIES_COMPAT_meta-pariani = "scarthgap"
LAYERDEPENDS_meta-pariani = "core qt5-layer"

# -----------------------------------------------------------------------------
# EULA and License configuration (Pariani)
# -----------------------------------------------------------------------------

# Main ST EULA for STM32MP platforms
EULA_FILE_ST = "${LAYERDIR}/conf/eula/${MACHINE}"
EULA_FILE_ST_MD5SUM = "8b505090fb679839cefbcc784afe8ce9"
```

## meta-pariani/conf/machine/stm32mp151-myir-cls.conf
```bitbake
#@TYPE: Machine
#@NAME: stm32mp151-myir-cls
#@DESCRIPTION: Pariani-custom STM32MP151 machine (CubeMX-based, MYIR board)

################################################################################
# Core STM32MP1 base machine configuration
################################################################################

# Ensure correct ST override order (must stay on a single line)
MACHINEOVERRIDES =. "stm32mpcommonmx:stm32mp1commonmx:stm32mp15commonmx:stm32mp1common:stm32mp15common:stm32mp151:stm32mpcommon:stm32mp151-myir-cls:"

# Include ST base machine configuration (also inherits external-dt)
require conf/machine/include/st-machine-common-stm32mp.inc
require conf/machine/include/st-machine-providers-stm32mp.inc

# Enable CubeMX external Device Tree integration
EXTERNAL_DT_ENABLED = "1"
ENABLE_CUBEMX_DTB   = "1"

# Allow optee to use external DTSs
CUBEMX_EXTDT_ENABLE_MK = "1"
CUBEMX_EXTDT_FORCE_MK = "1"

################################################################################
# CPU / Architecture
################################################################################
DEFAULTTUNE = "cortexa7thf-neon-vfpv4"
include conf/machine/include/arm/armv7a/tune-cortexa7.inc
SOC_FAMILY = "stm32mp1"

################################################################################
# Boot scheme OP-TEE (ST-compliant)
################################################################################

# Use full OP-TEE boot scheme (BL2 + BL31 + BL32 + BL33)
#BOOTSCHEME_LABELS = "opteemin"

# Add OP-TEE support to machine features
MACHINE_FEATURES += "optee"

# Provider OP-TEE raccomandato da ST
PREFERRED_PROVIDER_virtual-optee-os = "optee-os-stm32mp"

# IMPORTANT NOTE:
# Do NOT set FIP_CONFIG manually.  
# FIP generation is automatically handled by BOOTSCHEME="optee".
# Setting FIP_CONFIG here breaks the trusted-firmware-a recipe.

################################################################################
# Boot device support
################################################################################
#BOOTDEVICE_LABELS += "sdcard"
BOOTDEVICE_LABELS += "emmc"
#BOOTDEVICE_LABELS += "nand-4-256-1024"
#BOOTDEVICE_LABELS += "nor-sdcard"
################################################################################
# Machine features (default for stm32mp1 family)
################################################################################
#MACHINE_FEATURES:remove = "splashscreen"
# Enable hardware watchdog
MACHINE_FEATURES += "watchdog"
# Add GPU feature only if user accepted the ST EULA
MACHINE_FEATURES += "${@'gpu' if d.getVar('ACCEPT_EULA_'+d.getVar('MACHINE')) == '1' else ''}"

# Enable Cortex-M4 co-processor feature
MACHINE_FEATURES += "m4copro"

MACHINE_FEATURES += "fw-update"

################################################################################
# Flashlayout
################################################################################
FLASHLAYOUT_TYPE_LABELS:extensible = "${CUBEMX_DTB}"

################################################################################
# Optional feature toggles
################################################################################
#MACHINE_FEATURES += "bluetooth"
#MACHINE_FEATURES += "wifi"

################################################################################
# Kernel modules and firmware support
################################################################################
# Set the list of kernel module to be auto-loaded during boot
#KERNEL_MODULE_AUTOLOAD += ""

# Set Bluetooth related package list needed when 'bluetooth' feature is enabled
#BLUETOOTH_LIST += ""

# Set Wifi related package list needed when 'wifi' feature is enabled
#WIFI_LIST += ""

################################################################################
# CubeMX Project Configuration
################################################################################
# CubeMX-generated Device Tree basename
CUBEMX_DTB = "stm32mp151a-ap31085500a-mx"
# CubeMX project directory
CUBEMX_PROJECT = "${TOPDIR}/../layers/Yocto_STM32MP151/meta-pariani/mx/myir-cls"
# CubeMX project name (used in build integration)
CUBEMX_PROJECT_NAME = "AP31085500A"

# DDR size available on this board (MB)
CUBEMX_BOARD_DDR_SIZE = "512"

################################################################################
# Device Tree files used per storage type
################################################################################

STM32MP_DT_FILES_EMMC   += "${CUBEMX_DTB}"
STM32MP_DT_FILES_SDCARD += "${CUBEMX_DTB}"
#STM32MP_DT_FILES_NAND      += "${CUBEMX_DTB}"
#STM32MP_DT_FILES_NOR_all   += "${CUBEMX_DTB}"
#STM32MP_DT_FILES_NOR_mb    += "${CUBEMX_DTB}"
#STM32MP_DT_FILES_SPINAND   += "${CUBEMX_DTB}"
```
